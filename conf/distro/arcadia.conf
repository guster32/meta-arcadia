## conf/distro/arcadia.conf
```bitbake
# Distro Layer configuration

DISTRO = "arcadia"
DISTRO_NAME = "Arcadia-Linux"
DISTRO_VERSION = "1.0"
DISTRO_CODENAME = "physics"
SDK_VENDOR = "-arcadiasdk"
SDK_VERSION="${DISTRO_VERSION}"
MAINTAINER = "guster32@gmail.com"

TARGET_VENDOR = "-arcadia"

# Override these in poky based distros
#ARCADIA_DEFAULT_DISTRO_FEATURES = " bluetooth ext2 usbgadget usbhost xattr nfs zeroconf 3g"
DISTRO_FEATURES:append = " systemd wayland opengl gles ipv4 wifi ${DISTRO_FEATURES_LIBC} "

PACKAGECONFIG_CONFARGS:append_pn-systemd = " --disable-gtk --disable-x11"
NO_RECOMMENDATIONS = "1"
PACKAGECONFIG_pn-systemd = " \
    acl \
    kmod \
    pam \
    lz4 \
    libidn2 \
    libiptc \
    "

INIT_MANAGER = "systemd"
SDK_TOOLCHAIN_LANGS = "rust"
PACKAGE_CLASSES = "package_deb"
```

## conf/layer.conf
```bitbake
# We have a conf and classes directory, add to BBPATH
BBPATH .= ":${LAYERDIR}"

# We have recipes-* directories, add to BBFILES
BBFILES += "${LAYERDIR}/recipes-*/*/*.bb \
            ${LAYERDIR}/recipes-*/*/*.bbappend"
BBFILE_COLLECTIONS += "arcadia"
BBFILE_PATTERN_arcadia = "^${LAYERDIR}/"
BBFILE_PRIORITY_arcadia = "5"

LAYERDEPENDS_arcadia = "core"
LAYERSERIES_COMPAT_arcadia = "zeus"
```
